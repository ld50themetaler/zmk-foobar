## boards/shields/the_foobar_keyboard/Kconfig.defconfig
```kconfig
if SHIELD_THE_FOOBAR_KEYBOARD_LEFT || SHIELD_THE_FOOBAR_KEYBOARD_RIGHT

    config ZMK_KEYBOARD_NAME
        default "foobar"

    config ZMK_SPLIT
        default y

    config ZMK_POINTING
        default y

    config ZMK_NON_LIPO_BATTERY_MANAGEMENT
        default y

    config ZMK_NON_LIPO_MIN_MV
        default 1800

    config ZMK_NON_LIPO_MAX_MV
        default 3000

    config ZMK_NON_LIPO_LOW_MV
        default 2300

    config ZMK_NON_LIPO_ADV_SLEEP_TIMEOUT
        default 60000
endif
```

## boards/shields/the_foobar_keyboard/Kconfig.shield
```kconfig
config SHIELD_THE_FOOBAR_KEYBOARD_LEFT
    def_bool $(shields_list_contains,the_foobar_keyboard_left)
config SHIELD_THE_FOOBAR_KEYBOARD_RIGHT
    def_bool $(shields_list_contains,the_foobar_keyboard_right)
```
