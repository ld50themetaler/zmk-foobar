/ {
    chosen {
        zmk,battery = &non_lipo_battery;

    };

    vbatt: vbatt {
        // Disable default battery monitoring
        status = "disabled";
    };

    non_lipo_battery: non_lipo_battery {
        compatible = "zmk,non-lipo-battery";
        io-channels = <&adc 8>;  // vdd
    }; 
};
